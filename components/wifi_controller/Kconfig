## components/wifi_controller/Kconfig
```kconfig
# put here your custom config value
menu "Wi-Fi Controller"
    config SCAN_MAX_AP
        int "Maximun AP scanned"
        default 20
        help
        Maximum number of scanned nearby AP
    menu "COGECO397"
        config MGMT_AP_SSID
            string "COGECO397 SSID"
            default "COGECO397"
            help
            SSID of COGECO397

        config COGECO397_PASSWORD
            string "COGECO397 Password"
            default "mgmtadmin"
            help
            Password for COGECO397 WPA2 (minimum 8 characters)

        config MGMT_AP_CHANNEL
            int "COGECO397 channel"
            range 1 13
            default 3
            help
            Channel on which COGECO397 should run
            
        config MGMT_AP_MAX_CONNECTIONS
            int "Maximum number of connected clients"
            range 0 10
            default 1
            help
            Password for COGECO397

        config MGMT_AP_AUTH_ON
            bool "Password protected COGECO397"
            default y
            help
                If set to true, WPA2-PSK will be used. Otherwise authentication will be open
                and anyone can connect to this COGECO397.
    endmenu
endmenu
```
